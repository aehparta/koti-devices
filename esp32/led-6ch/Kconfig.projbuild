## esp32/led-6ch/Kconfig.projbuild
```kconfig
menu "LED Controller Configuration"
    config MQTT_PREFIX
        string "MQTT topic prefix"
        default "koti/devices/"
    config MQTT_BROKER_URL
        string "Broker URL (use mDNS if empty)"
        help
            URL of the broker to connect to, or empty to use mDNS
    config MQTT_MDNS_SERVICE
        string "mDNS service to query"
        default "_mqtt"
    config MQTT_MDNS_PROTO
        string "mDNS proto to query"
        default "_tcp"
endmenu
```

## esp32/led-6ch/sdkconfig.defaults
```kconfig
CONFIG_ESP32_DEFAULT_CPU_FREQ_80=y
CONFIG_COMPILER_OPTIMIZATION_PERF=y
CONFIG_ESPTOOLPY_BAUD_921600B=y
CONFIG_LOG_DEFAULT_LEVEL_INFO=y
```
